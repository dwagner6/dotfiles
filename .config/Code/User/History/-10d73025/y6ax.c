#include "i2c0.h"
#include "uclib.h"
#include <rp2040/i2c.h>
#include <stdint.h>
#include <stdbool.h>

#define I2C_ADDR           0x74
#define REF_LSB_REG        0x00
#define REF_MSB_REG        0x01 
#define REF_MSB_REG_MASK   0x03    // only lowest 3 bits of REF_MSB are used
#define IOUT_LIMIT_REG     0x02 
#define VOUT_FS_REG        0x04
#define VOUT_FS_REG_MASK   0x83    // only bits 7, 1, 0 used
#define MODE_REG           0x06
#define STATUS_REG         0x07
#define OE_BIT             7
#define HICCUP_BIT         5    // default on reset
#define DSCHG_BIT          4

static const uint16_t voltage_lookup[171] = {
    0x00dcU, 0x00e6U, 0x00f0U, 0x00faU, 0x0104U, 0x010eU, 0x0118U, 0x0122U, 0x012cU, 0x0136U,
    0x0140U, 0x014aU, 0x0154U, 0x015eU, 0x0168U, 0x0172U, 0x017cU, 0x0186U, 0x0190U, 0x019aU,
    0x01a4U, 0x01aeU, 0x01b8U, 0x01c2U, 0x01ccU, 0x01d6U, 0x01e0U, 0x01eaU, 0x01f4U, 0x01feU,
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    0x071cU, 0x0726U, 0x0730U, 0x073aU, 0x0744U, 0x074eU, 0x0758U, 0x0762U, 0x076cU, 0x0776U,
    0x0780U
};

_Bool tps55289_enable_output()
{
    uint16_t trans[2];
    trans[0] = MODE_REG;
    trans[1] = (1 << OE_BIT) | (1 << HICCUP_BIT) | I2C_STOP;
    if(i2c0_do_transaction(I2C_ADDR, 2, trans))
        return true;
    else
        return false;
}

_Bool tps55289_disable_output()
{
    uint16_t trans[2];
    trans[0] = MODE_REG;
    trans[1] = (1 << DSCHG_BIT) | (1 << HICCUP_BIT) | I2C_STOP;
    if(i2c0_do_transaction(I2C_ADDR, 2, trans))
        return true;
    else
        return false;
}

_Bool tps55289_set_vout(uint16_t vout_set_mv)
{
    
    print_string("ref_value: ");
    print_hex(4, ref_value);
    print_string("\n\r");

    uint16_t trans[3];
    trans[0] = REF_LSB_REG;
    trans[1] = ref_value & 0x00ff;
    trans[2] = ref_value & 0x0700 | I2C_STOP;
    if(i2c0_do_transaction(I2C_ADDR, 3, trans))
        return true;
    else 
        return false;
}